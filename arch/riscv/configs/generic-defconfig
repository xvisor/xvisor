## arch/riscv/configs/generic-defconfig
```kconfig
CONFIG_ARCH_RISCV=y
CONFIG_RISCV_CPU_GENERIC=y
CONFIG_CMODEL_MEDANY=y
CONFIG_RISCV_BOARD_GENERIC=y
CONFIG_SCHEDALGO_PRR=y
CONFIG_TSLICE_10MS=y
CONFIG_BLOCK=y
CONFIG_NET=y
CONFIG_VIRTIO=y
CONFIG_VMSG=y
CONFIG_VSERIAL=y
CONFIG_VSPI=y
CONFIG_VDISK=y
CONFIG_VDISPLAY=y
CONFIG_VINPUT=y
CONFIG_VSDAEMON=y
CONFIG_VSDAEMON_CHARDEV=y
CONFIG_VSDAEMON_MTERM=y
CONFIG_VFS=y
CONFIG_VFS_CPIO=y
CONFIG_VFS_EXT4=y
CONFIG_VFS_FAT=y
CONFIG_SCSI=y
CONFIG_SCSI_DISK=y
CONFIG_RISCV_INTC=y
CONFIG_RISCV_TIMER=y
CONFIG_SERIAL=y
CONFIG_SERIAL_8250_UART=y
CONFIG_BLOCK_RBD=y
CONFIG_BLOCK_INITRD=y
CONFIG_BLOCK_VIRTIO_HOST=y
CONFIG_VIRTIO_HOST=y
CONFIG_VIRTIO_HOST_MMIO=y
```

## arch/x86/configs/x86_64_generic-defconfig
```kconfig
CONFIG_ARCH_x86=y
CONFIG_VAPOOL_SIZE_MB=16
CONFIG_CPU_X86_64=y
CONFIG_LOCAL_APIC=y
CONFIG_VEXT_AMD_SVM=y
CONFIG_VEXT_INTEL_VTX=y
CONFIG_BOARD_X86_64_GENERIC=y
CONFIG_PCI_DIRECT=y
CONFIG_X86_LEGACY_HOST=y
CONFIG_SCHEDALGO_PRR=y
CONFIG_TSLICE_10MS=y
CONFIG_BLOCK=y
CONFIG_VSERIAL=y
CONFIG_VDISK=y
CONFIG_VINPUT=y
# CONFIG_VINPUT_KEYMAP_AR is not set
# CONFIG_VINPUT_KEYMAP_BEPO is not set
# CONFIG_VINPUT_KEYMAP_CZ is not set
# CONFIG_VINPUT_KEYMAP_DA is not set
# CONFIG_VINPUT_KEYMAP_DE_CH is not set
# CONFIG_VINPUT_KEYMAP_DE is not set
# CONFIG_VINPUT_KEYMAP_EN_GB is not set
# CONFIG_VINPUT_KEYMAP_ES is not set
# CONFIG_VINPUT_KEYMAP_ET is not set
# CONFIG_VINPUT_KEYMAP_FI is not set
# CONFIG_VINPUT_KEYMAP_FO is not set
# CONFIG_VINPUT_KEYMAP_FR_BE is not set
# CONFIG_VINPUT_KEYMAP_FR_CA is not set
# CONFIG_VINPUT_KEYMAP_FR_CH is not set
# CONFIG_VINPUT_KEYMAP_FR is not set
# CONFIG_VINPUT_KEYMAP_HR is not set
# CONFIG_VINPUT_KEYMAP_HU is not set
# CONFIG_VINPUT_KEYMAP_IS is not set
# CONFIG_VINPUT_KEYMAP_IT is not set
# CONFIG_VINPUT_KEYMAP_JA is not set
# CONFIG_VINPUT_KEYMAP_LT is not set
# CONFIG_VINPUT_KEYMAP_LV is not set
# CONFIG_VINPUT_KEYMAP_MK is not set
# CONFIG_VINPUT_KEYMAP_NL_BE is not set
# CONFIG_VINPUT_KEYMAP_NL is not set
# CONFIG_VINPUT_KEYMAP_NO is not set
# CONFIG_VINPUT_KEYMAP_PL is not set
# CONFIG_VINPUT_KEYMAP_PT_BR is not set
# CONFIG_VINPUT_KEYMAP_PT is not set
# CONFIG_VINPUT_KEYMAP_RU is not set
# CONFIG_VINPUT_KEYMAP_SL is not set
# CONFIG_VINPUT_KEYMAP_SV is not set
# CONFIG_VINPUT_KEYMAP_TH is not set
# CONFIG_VINPUT_KEYMAP_TR is not set
CONFIG_VSDAEMON=y
CONFIG_VSDAEMON_CHARDEV=y
CONFIG_VSDAEMON_MTERM=y
CONFIG_VTEMU=y
CONFIG_VFS=y
CONFIG_VFS_EXT4=y
CONFIG_VFS_FAT=y
CONFIG_CRYPTO=y
CONFIG_LIBAUTH=y
CONFIG_LIBAUTH_USE_MD5_PASSWD=y
CONFIG_LIBAUTH_DEFAULT_USER=y
CONFIG_SERIAL=y
CONFIG_SERIAL_8250_UART=y
CONFIG_BLOCK_RBD=y
CONFIG_BLOCK_INITRD=y
CONFIG_PCI=y
CONFIG_INPUT=y
CONFIG_INPUT_KEYBOARD=y
CONFIG_KEYBOARD_ATKBD=y
CONFIG_SERIO_I8042=y
CONFIG_FB=y
CONFIG_FB_VESA=y
CONFIG_IDE=y
CONFIG_PIIX3_IDE=y
CONFIG_EMU_VIRTIO=y
CONFIG_EMU_VIRTIO_PCI=y
CONFIG_EMU_PIC=y
CONFIG_EMU_PIC_I8259=y
CONFIG_EMU_PIC_LAPIC=y
CONFIG_EMU_TIMER=y
CONFIG_EMU_TIMER_INTEL_8254=y
CONFIG_EMU_TIMER_HPET=y
CONFIG_EMU_MISC_ZERO=y
CONFIG_EMU_MISC_PSM=y
CONFIG_EMU_MISC_FW_CFG=y
CONFIG_EMU_BLOCK=y
CONFIG_EMU_BLOCK_VIRTIO=y
CONFIG_EMU_INPUT=y
CONFIG_EMU_INPUT_PS2=y
CONFIG_EMU_INPUT_I8042=y
CONFIG_EMU_SERIAL=y
CONFIG_EMU_SERIAL_NS16550=y
CONFIG_EMU_RTC=y
CONFIG_EMU_RTC_MC146818=y
CONFIG_EMU_PCI=y
```
