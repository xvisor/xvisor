
/dts-v1/;

/include/ "foundation-v8.dtsi"

/ {
	chosen {
		console = &SERIAL0;
		bootcmd = /* Create rbd0 device */
			  "rbd create rbd0 0x81000000 0x01000000",

			  /* Mount rbd0 device */
			  "vfs mount rbd0 /",

			  /* Copy guest0 device tree from templates */
			  "devtree node copy /guests guest0 /templates/virt-v8x2",

			  /* Update guest0 flash region */
			  "devtree attr set /guests/guest0/aspace/nor_flash0 host_physical_addr physaddr 0x82000000",
			  "devtree attr set /guests/guest0/aspace/nor_flash0 physical_size physsize 0x01000000",

			  /* Update guest0 memory regions */
			  "devtree attr set /guests/guest0/aspace/mem0 host_physical_addr physaddr 0x83000000",
			  "devtree attr set /guests/guest0/aspace/mem0 physical_size physsize 0x06000000",

			  /* Update guest0 vGIC CPU interface regions */
			  "devtree attr set /guests/guest0/aspace/gic_cpu host_physical_addr physaddr 0x2C006000",

			  /* Connect guest0/virtio-net0 netport to br0 */
			  "devtree attr set /guests/guest0/aspace/virtio-net0 switch string br0",

			  /* Create guest0 */
			  "guest create guest0",

			  /* Load guest0 images */
			  "vfs guest_load_list guest0 /images/arm64/virt-v8/nor_flash.list";
	};
};

