## arch/arm/configs/generic-v5-defconfig
```kconfig
CONFIG_ARCH_ARM=y
CONFIG_CPU_GENERIC_V5=y
CONFIG_ARM_MAX_DTB_SIZE=0x10000
CONFIG_BOARD_GENERIC=y
CONFIG_GENERIC_IMX2X=y
CONFIG_MAX_VCPU_COUNT=48
CONFIG_SCHEDALGO_PRR=y
CONFIG_TSLICE_10MS=y
CONFIG_BLOCK=y
CONFIG_NET=y
CONFIG_VSERIAL=y
CONFIG_VDISK=y
CONFIG_VDISPLAY=y
CONFIG_VINPUT=y
CONFIG_VSDAEMON=y
CONFIG_VSDAEMON_CHARDEV=y
CONFIG_VSDAEMON_MTERM=y
CONFIG_VTEMU=y
CONFIG_VFS=y
CONFIG_VFS_EXT4=y
CONFIG_VFS_FAT=y
CONFIG_IMAGE_LOADER=y
CONFIG_ARM_VIC=y
CONFIG_VERSATILE_FPGA_IRQ=y
CONFIG_MXC_AVIC=y
CONFIG_ARM_TIMER_SP804=y
CONFIG_MXC_EPIT=y
CONFIG_MXC_GPT=y
CONFIG_SERIAL=y
CONFIG_SERIAL_8250_UART=y
CONFIG_SERIAL_PL01X=y
CONFIG_SERIAL_IMX=y
CONFIG_RTC=y
CONFIG_RTC_PL031=y
CONFIG_BLOCK_RBD=y
CONFIG_BLOCK_INITRD=y
CONFIG_INPUT=y
CONFIG_INPUT_KEYBOARD=y
CONFIG_KEYBOARD_ATKBD=y
CONFIG_INPUT_MOUSEDEV=y
CONFIG_MOUSE_PS2=y
CONFIG_SERIO_AMBAKMI=y
CONFIG_FB=y
CONFIG_FB_ARMCLCD=y
CONFIG_NET_DEVICES=y
CONFIG_ETHERNET_DRIVERS=y
CONFIG_ETHER_SMSC_91x=y
CONFIG_MICREL_PHY=y
CONFIG_COMMON_CLK_VERSATILE=y
CONFIG_COMMON_CLK_MXC=y
CONFIG_GPIO_GENERIC_PLATFORM=y
CONFIG_PINCTRL=y
CONFIG_PINCTRL_IMX25=y
CONFIG_SPI=y
CONFIG_SPI_IMX=y
CONFIG_I2C=y
CONFIG_I2C_IMX=y
CONFIG_EMU_VIRTIO=y
CONFIG_EMU_VIRTIO_MMIO=y
CONFIG_EMU_SYS=y
CONFIG_EMU_SYS_ARM_SYSREGS=y
CONFIG_EMU_SYS_SP810=y
CONFIG_EMU_SYS_VMINFO=y
CONFIG_EMU_PIC=y
CONFIG_EMU_PIC_PL190=y
CONFIG_EMU_TIMER=y
CONFIG_EMU_TIMER_SP804=y
CONFIG_EMU_MISC_ZERO=y
CONFIG_EMU_PT_PLATFORM=y
CONFIG_EMU_NET=y
CONFIG_EMU_NET_SMC91C111=y
CONFIG_EMU_NET_VIRTIO=y
CONFIG_EMU_BLOCK=y
CONFIG_EMU_BLOCK_VIRTIO=y
CONFIG_EMU_DISPLAY=y
CONFIG_EMU_DISPLAY_PL110=y
CONFIG_EMU_DISPLAY_SIMPLEFB=y
CONFIG_EMU_INPUT=y
CONFIG_EMU_INPUT_PS2=y
CONFIG_EMU_INPUT_PL050=y
CONFIG_EMU_SERIAL=y
CONFIG_EMU_SERIAL_PL011=y
CONFIG_EMU_CONSOLE=y
CONFIG_EMU_CONSOLE_VIRTIO=y
CONFIG_EMU_RTC=y
CONFIG_EMU_RTC_PL031=y
CONFIG_EMU_GPIO=y
CONFIG_EMU_GPIO_PL061=y
CONFIG_EMU_GPIO_POWER=y
CONFIG_EMU_GPIO_FORWARD=y
CONFIG_EMU_WDT=y
CONFIG_EMU_WDT_SP805=y
```

## arch/arm/configs/generic-v7-defconfig
```kconfig
CONFIG_ARCH_ARM=y
CONFIG_CPU_GENERIC_V7=y
CONFIG_ARM_MAX_DTB_SIZE=0x10000
CONFIG_BOARD_GENERIC=y
CONFIG_GENERIC_OMAP3=y
CONFIG_GENERIC_EXYNOS4=y
CONFIG_ARM_SMP_PSCI=y
CONFIG_ARM_SMP_IMX=y
CONFIG_MAX_VCPU_COUNT=48
CONFIG_SCHEDALGO_PRR=y
CONFIG_TSLICE_10MS=y
CONFIG_BLOCK=y
CONFIG_NET=y
CONFIG_VSERIAL=y
CONFIG_VDISK=y
CONFIG_VDISPLAY=y
CONFIG_VINPUT=y
CONFIG_VSCREEN=y
CONFIG_VSDAEMON=y
CONFIG_VSDAEMON_CHARDEV=y
CONFIG_VSDAEMON_MTERM=y
CONFIG_VTEMU=y
CONFIG_VFS=y
CONFIG_VFS_EXT4=y
CONFIG_VFS_FAT=y
CONFIG_IMAGE_LOADER=y
CONFIG_SUN4I_VIC=y
CONFIG_OMAP_INTC=y
CONFIG_ARM_TIMER_SP804=y
CONFIG_ARM_TWD=y
CONFIG_MXC_EPIT=y
CONFIG_OMAP_S32K=y
CONFIG_OMAP2_TIMER=y
CONFIG_SUN4I_TIMER=y
CONFIG_SERIAL_8250_UART=y
CONFIG_SERIAL_OMAP_UART=y
CONFIG_SERIAL_PL01X=y
CONFIG_SERIAL_IMX=y
CONFIG_RTC=y
CONFIG_RTC_PL031=y
CONFIG_BLOCK_RBD=y
CONFIG_BLOCK_INITRD=y
CONFIG_MTD=y
CONFIG_MTD_M25P80=y
CONFIG_MMC=y
CONFIG_MMC_ARMMMCI=y
CONFIG_MMC_SUNXI=y
CONFIG_INPUT=y
CONFIG_INPUT_KEYBOARD=y
CONFIG_KEYBOARD_ATKBD=y
CONFIG_INPUT_MOUSEDEV=y
CONFIG_MOUSE_PS2=y
CONFIG_SERIO_AMBAKMI=y
CONFIG_FB=y
CONFIG_FB_ARMCLCD=y
CONFIG_IMX_IPUV3_CORE=y
CONFIG_FB_MXC=y
CONFIG_FB_MXC_LDB=y
CONFIG_NET_DEVICES=y
CONFIG_ETHERNET_DRIVERS=y
CONFIG_ETHER_SMSC_911x=y
CONFIG_ETHER_SMSC_91x=y
CONFIG_ETHER_ALLWINNER_SUN4I_EMAC=y
CONFIG_MDIO_SUN4I=y
CONFIG_COMMON_CLK_SUNXI=y
CONFIG_POWER_SUPPLY=y
CONFIG_POWER_RESET=y
CONFIG_POWER_RESET_REALVIEW=y
CONFIG_POWER_RESET_VEXPRESS=y
CONFIG_POWER_RESET_SUN4I=y
CONFIG_PINCTRL=y
CONFIG_PINCTRL_SUNXI=y
CONFIG_PINCTRL_IMX6Q=y
CONFIG_SPI=y
CONFIG_SPI_IMX=y
CONFIG_I2C=y
CONFIG_I2C_IMX=y
CONFIG_PWM=y
CONFIG_PWM_IMX=y
CONFIG_RESET_CONTROLLER=y
CONFIG_IMX_RESET=y
CONFIG_SRAM=y
CONFIG_EMU_VIRTIO=y
CONFIG_EMU_VIRTIO_MMIO=y
CONFIG_EMU_SYS=y
CONFIG_EMU_SYS_ARM_SYSREGS=y
CONFIG_EMU_SYS_SP810=y
CONFIG_EMU_PIC=y
CONFIG_EMU_PIC_GIC=y
CONFIG_EMU_PIC_PL190=y
CONFIG_EMU_TIMER=y
CONFIG_EMU_TIMER_SP804=y
CONFIG_EMU_TIMER_ARM_MPTIMER=y
CONFIG_EMU_CACHE_L2X0=y
CONFIG_EMU_MISC_ZERO=y
CONFIG_EMU_MISC_ARM11MPCORE=y
CONFIG_EMU_MISC_A9MPCORE=y
CONFIG_EMU_PT_SIMPLE=y
CONFIG_EMU_NET=y
CONFIG_EMU_NET_LAN9118=y
CONFIG_EMU_NET_SMC91C111=y
CONFIG_EMU_NET_VIRTIO=y
CONFIG_EMU_BLOCK=y
CONFIG_EMU_BLOCK_VIRTIO=y
CONFIG_EMU_DISPLAY=y
CONFIG_EMU_DISPLAY_PL110=y
CONFIG_EMU_INPUT=y
CONFIG_EMU_INPUT_PS2=y
CONFIG_EMU_INPUT_PL050=y
CONFIG_EMU_SERIAL=y
CONFIG_EMU_SERIAL_PL011=y
CONFIG_EMU_CONSOLE=y
CONFIG_EMU_CONSOLE_VIRTIO=y
CONFIG_EMU_RTC=y
CONFIG_EMU_RTC_PL031=y
CONFIG_EMU_GPIO=y
CONFIG_EMU_GPIO_PL061=y
CONFIG_EMU_WDT=y
CONFIG_EMU_WDT_SP805=y
```

## arch/arm/configs/generic-v7-ve-defconfig
```kconfig
CONFIG_ARCH_ARM=y
CONFIG_CPU_GENERIC_V7_VE=y
CONFIG_SMP=y
CONFIG_ARM_VGIC=y
CONFIG_ARM_MAX_DTB_SIZE=0x10000
CONFIG_BOARD_GENERIC=y
CONFIG_ARM_SMP_PSCI=y
CONFIG_SCHEDALGO_PRR=y
CONFIG_TSLICE_10MS=y
CONFIG_BLOCK=y
CONFIG_NET=y
CONFIG_VSERIAL=y
CONFIG_VDISK=y
CONFIG_VDISPLAY=y
CONFIG_VINPUT=y
CONFIG_VSCREEN=y
CONFIG_VSDAEMON=y
CONFIG_VSDAEMON_CHARDEV=y
CONFIG_VSDAEMON_MTERM=y
CONFIG_VTEMU=y
CONFIG_VFS=y
CONFIG_VFS_EXT4=y
CONFIG_VFS_FAT=y
CONFIG_IMAGE_LOADER=y
CONFIG_ARM_GIC=y
CONFIG_ARM_GIC_V3=y
CONFIG_BCM2835_INTC=y
CONFIG_BCM2836_LOCAL_INTC=y
CONFIG_ARM_TIMER_SP804=y
CONFIG_ARM_TWD=y
CONFIG_BCM2835_TIMER=y
CONFIG_SUN4I_TIMER=y
CONFIG_SERIAL=y
CONFIG_SERIAL_8250_UART=y
CONFIG_SERIAL_PL01X=y
CONFIG_RTC=y
CONFIG_RTC_PL031=y
CONFIG_BLOCK_RBD=y
CONFIG_BLOCK_INITRD=y
CONFIG_MMC=y
CONFIG_MMC_ARMMMCI=y
CONFIG_MMC_SDHCI=y
CONFIG_MMC_SDHCI_BCM2835=y
CONFIG_INPUT=y
CONFIG_INPUT_KEYBOARD=y
CONFIG_KEYBOARD_ATKBD=y
CONFIG_INPUT_MOUSEDEV=y
CONFIG_MOUSE_PS2=y
CONFIG_SERIO_AMBAKMI=y
CONFIG_FB=y
CONFIG_FB_ARMCLCD=y
CONFIG_NET_DEVICES=y
CONFIG_ETHERNET_DRIVERS=y
CONFIG_ETHER_SMSC_911x=y
CONFIG_ETHER_SMSC_91x=y
CONFIG_ETHER_ALLWINNER_SUN4I_EMAC=y
CONFIG_COMMON_CLK_VERSATILE=y
CONFIG_COMMON_CLK_BCM2835=y
CONFIG_COMMON_CLK_SUNXI=y
CONFIG_POWER_SUPPLY=y
CONFIG_POWER_RESET=y
CONFIG_POWER_RESET_VEXPRESS=y
CONFIG_POWER_RESET_BCM2835=y
CONFIG_MAILBOX=y
CONFIG_BCM2835_MBOX=y
CONFIG_GPIOLIB=y
CONFIG_GPIO_GENERIC_PLATFORM=y
CONFIG_OF_GPIO=y
CONFIG_SPI=y
CONFIG_SPI_BCM2835=y
CONFIG_I2C=y
CONFIG_I2C_BCM2835=y
CONFIG_RASPBERRYPI_FIRMWARE=y
CONFIG_EMU_VIRTIO=y
CONFIG_EMU_VIRTIO_MMIO=y
CONFIG_EMU_SYS=y
CONFIG_EMU_SYS_ARM_SYSREGS=y
CONFIG_EMU_SYS_SP810=y
CONFIG_EMU_SYS_VMINFO=y
CONFIG_EMU_PIC=y
CONFIG_EMU_PIC_GIC=y
CONFIG_EMU_PIC_PL190=y
CONFIG_EMU_TIMER=y
CONFIG_EMU_TIMER_SP804=y
CONFIG_EMU_TIMER_ARM_MPTIMER=y
CONFIG_EMU_CACHE_L2X0=y
CONFIG_EMU_MISC_ZERO=y
CONFIG_EMU_MISC_ARM11MPCORE=y
CONFIG_EMU_MISC_A9MPCORE=y
CONFIG_EMU_PT_PLATFORM=y
CONFIG_EMU_NET=y
CONFIG_EMU_NET_LAN9118=y
CONFIG_EMU_NET_SMC91C111=y
CONFIG_EMU_NET_VIRTIO=y
CONFIG_EMU_BLOCK=y
CONFIG_EMU_BLOCK_VIRTIO=y
CONFIG_EMU_DISPLAY=y
CONFIG_EMU_DISPLAY_PL110=y
CONFIG_EMU_DISPLAY_SIMPLEFB=y
CONFIG_EMU_INPUT=y
CONFIG_EMU_INPUT_PS2=y
CONFIG_EMU_INPUT_PL050=y
CONFIG_EMU_SERIAL=y
CONFIG_EMU_SERIAL_PL011=y
CONFIG_EMU_CONSOLE=y
CONFIG_EMU_CONSOLE_VIRTIO=y
CONFIG_EMU_RTC=y
CONFIG_EMU_RTC_PL031=y
CONFIG_EMU_GPIO=y
CONFIG_EMU_GPIO_PL061=y
CONFIG_EMU_GPIO_POWER=y
CONFIG_EMU_WDT=y
CONFIG_EMU_WDT_SP805=y
```

## arch/arm/configs/generic-v8-defconfig
```kconfig
CONFIG_ARCH_ARM=y
CONFIG_CPU_GENERIC_V8=y
CONFIG_SMP=y
CONFIG_VAPOOL_SIZE_MB=16
CONFIG_ARM_VGIC=y
CONFIG_ARM_MAX_DTB_SIZE=0x10000
CONFIG_BOARD_GENERIC=y
CONFIG_ARM_SMP_PSCI=y
CONFIG_SCHEDALGO_PRR=y
CONFIG_TSLICE_10MS=y
CONFIG_BLOCK=y
CONFIG_NET=y
CONFIG_VSERIAL=y
CONFIG_VDISK=y
CONFIG_VDISPLAY=y
CONFIG_VINPUT=y
CONFIG_VSCREEN=y
CONFIG_VSDAEMON=y
CONFIG_VSDAEMON_CHARDEV=y
CONFIG_VSDAEMON_MTERM=y
CONFIG_VTEMU=y
CONFIG_VFS=y
CONFIG_VFS_EXT4=y
CONFIG_VFS_FAT=y
CONFIG_IMAGE_LOADER=y
CONFIG_ARM_GIC=y
CONFIG_ARM_GIC_V3=y
CONFIG_BCM2835_INTC=y
CONFIG_BCM2836_LOCAL_INTC=y
CONFIG_BCM2835_TIMER=y
CONFIG_SERIAL=y
CONFIG_SERIAL_8250_UART=y
CONFIG_SERIAL_PL01X=y
CONFIG_SERIAL_BCM283X_MU=y
CONFIG_RTC=y
CONFIG_RTC_PL031=y
CONFIG_BLOCK_RBD=y
CONFIG_BLOCK_INITRD=y
CONFIG_MMC=y
CONFIG_MMC_SDHCI=y
CONFIG_MMC_SDHCI_BCM2835=y
CONFIG_INPUT=y
CONFIG_FB=y
CONFIG_FB_ARMCLCD=y
CONFIG_NET_DEVICES=y
CONFIG_ETHERNET_DRIVERS=y
CONFIG_ETHER_SMSC_91x=y
CONFIG_COMMON_CLK_BCM2835=y
CONFIG_POWER_SUPPLY=y
CONFIG_POWER_RESET=y
CONFIG_POWER_RESET_BCM2835=y
CONFIG_I2C=y
CONFIG_I2C_BCM2835=y
CONFIG_EMU_VIRTIO=y
CONFIG_EMU_VIRTIO_MMIO=y
CONFIG_EMU_SYS=y
CONFIG_EMU_SYS_ARM_SYSREGS=y
CONFIG_EMU_SYS_SP810=y
CONFIG_EMU_SYS_VMINFO=y
CONFIG_EMU_PIC=y
CONFIG_EMU_PIC_GIC=y
CONFIG_EMU_PIC_PL190=y
CONFIG_EMU_TIMER=y
CONFIG_EMU_TIMER_SP804=y
CONFIG_EMU_TIMER_ARM_MPTIMER=y
CONFIG_EMU_CACHE_L2X0=y
CONFIG_EMU_MISC_ZERO=y
CONFIG_EMU_MISC_ARM11MPCORE=y
CONFIG_EMU_MISC_A9MPCORE=y
CONFIG_EMU_PT_SIMPLE=y
CONFIG_EMU_NET=y
CONFIG_EMU_NET_LAN9118=y
CONFIG_EMU_NET_SMC91C111=y
CONFIG_EMU_NET_VIRTIO=y
CONFIG_EMU_BLOCK=y
CONFIG_EMU_BLOCK_VIRTIO=y
CONFIG_EMU_DISPLAY=y
CONFIG_EMU_DISPLAY_PL110=y
CONFIG_EMU_DISPLAY_SIMPLEFB=y
CONFIG_EMU_INPUT=y
CONFIG_EMU_INPUT_PS2=y
CONFIG_EMU_INPUT_PL050=y
CONFIG_EMU_SERIAL=y
CONFIG_EMU_SERIAL_PL011=y
CONFIG_EMU_CONSOLE=y
CONFIG_EMU_CONSOLE_VIRTIO=y
CONFIG_EMU_RTC=y
CONFIG_EMU_RTC_PL031=y
CONFIG_EMU_GPIO=y
CONFIG_EMU_GPIO_PL061=y
CONFIG_EMU_WDT=y
CONFIG_EMU_WDT_SP805=y
```

## arch/arm/configs/imx6-defconfig
```kconfig
CONFIG_ARCH_ARM=y
CONFIG_CPU_GENERIC_V7=y
CONFIG_CPU_COUNT=4
CONFIG_BOARD_GENERIC=y
# CONFIG_GENERIC_REALVIEW is not set
# CONFIG_GENERIC_VEXPRESS is not set
CONFIG_MAX_VCPU_COUNT=16
CONFIG_MAX_GUEST_COUNT=4
CONFIG_DMA_HEAP_SIZE_KB=3072
CONFIG_SCHEDALGO_PRR=y
CONFIG_TSLICE_10MS=y
CONFIG_BLOCK=y
CONFIG_NET=y
CONFIG_NET_MBUF_EXT_POOL_SIZE_KB=128
CONFIG_VSERIAL=y
CONFIG_VDISK=y
CONFIG_VDISPLAY=y
CONFIG_VINPUT=y
# CONFIG_VINPUT_KEYMAP_AR is not set
# CONFIG_VINPUT_KEYMAP_BEPO is not set
# CONFIG_VINPUT_KEYMAP_CZ is not set
# CONFIG_VINPUT_KEYMAP_DA is not set
# CONFIG_VINPUT_KEYMAP_DE_CH is not set
# CONFIG_VINPUT_KEYMAP_DE is not set
# CONFIG_VINPUT_KEYMAP_EN_GB is not set
# CONFIG_VINPUT_KEYMAP_ES is not set
# CONFIG_VINPUT_KEYMAP_ET is not set
# CONFIG_VINPUT_KEYMAP_FI is not set
# CONFIG_VINPUT_KEYMAP_FO is not set
# CONFIG_VINPUT_KEYMAP_FR_BE is not set
# CONFIG_VINPUT_KEYMAP_FR_CA is not set
# CONFIG_VINPUT_KEYMAP_FR_CH is not set
# CONFIG_VINPUT_KEYMAP_FR is not set
# CONFIG_VINPUT_KEYMAP_HR is not set
# CONFIG_VINPUT_KEYMAP_HU is not set
# CONFIG_VINPUT_KEYMAP_IS is not set
# CONFIG_VINPUT_KEYMAP_IT is not set
# CONFIG_VINPUT_KEYMAP_JA is not set
# CONFIG_VINPUT_KEYMAP_LT is not set
# CONFIG_VINPUT_KEYMAP_LV is not set
# CONFIG_VINPUT_KEYMAP_MK is not set
# CONFIG_VINPUT_KEYMAP_NL_BE is not set
# CONFIG_VINPUT_KEYMAP_NL is not set
# CONFIG_VINPUT_KEYMAP_NO is not set
# CONFIG_VINPUT_KEYMAP_PL is not set
# CONFIG_VINPUT_KEYMAP_PT_BR is not set
# CONFIG_VINPUT_KEYMAP_PT is not set
# CONFIG_VINPUT_KEYMAP_RU is not set
# CONFIG_VINPUT_KEYMAP_SL is not set
# CONFIG_VINPUT_KEYMAP_SV is not set
# CONFIG_VINPUT_KEYMAP_TH is not set
# CONFIG_VINPUT_KEYMAP_TR is not set
CONFIG_VSCREEN=y
CONFIG_NET_STACK=y
CONFIG_NET_STACK_LWIP=y
CONFIG_VSDAEMON=y
CONFIG_VSDAEMON_CHARDEV=y
CONFIG_VSDAEMON_MTERM=y
CONFIG_VSDAEMON_TELNET=y
CONFIG_VTEMU=y
CONFIG_VFS=y
CONFIG_VFS_EXT4=y
CONFIG_VFS_FAT=y
CONFIG_IMAGE_LOADER=y
CONFIG_ARM_GIC=y
CONFIG_ARM_TWD=y
CONFIG_MXC_EPIT=y
CONFIG_MXC_GPT=y
CONFIG_SERIAL=y
CONFIG_SERIAL_IMX=y
CONFIG_BLOCK_RBD=y
CONFIG_MTD=y
CONFIG_MTD_M25P80=y
CONFIG_MMC=y
CONFIG_MMC_SDHCI=y
CONFIG_MMC_SDHCI_ESDHC_IMX=y
CONFIG_INPUT=y
CONFIG_INPUT_KEYBOARD=y
CONFIG_KEYBOARD_ATKBD=y
CONFIG_INPUT_MOUSEDEV=y
CONFIG_FB=y
CONFIG_IMX_IPUV3_CORE=y
CONFIG_FB_MXC=y
CONFIG_FB_MXC_LDB=y
CONFIG_FB_BACKLIGHT=y
CONFIG_FB_BACKLIGHT_PWM=y
CONFIG_NET_DEVICES=y
CONFIG_ETHERNET_DRIVERS=y
CONFIG_MICREL_PHY=y
CONFIG_GPIO_GENERIC_PLATFORM=y
CONFIG_PINCTRL=y
CONFIG_PINCTRL_IMX6Q=y
CONFIG_SPI=y
CONFIG_SPI_IMX=y
CONFIG_I2C=y
CONFIG_I2C_IMX=y
CONFIG_PWM=y
CONFIG_PWM_IMX=y
CONFIG_RESET_CONTROLLER=y
CONFIG_IMX_RESET=y
CONFIG_SRAM=y
CONFIG_EMU_VIRTIO=y
CONFIG_EMU_VIRTIO_MMIO=y
CONFIG_EMU_SYS=y
CONFIG_EMU_SYS_ARM_SYSREGS=y
CONFIG_EMU_SYS_SP810=y
CONFIG_EMU_SYS_VMINFO=y
CONFIG_EMU_PIC=y
CONFIG_EMU_PIC_GIC=y
CONFIG_EMU_TIMER=y
CONFIG_EMU_TIMER_SP804=y
CONFIG_EMU_TIMER_ARM_MPTIMER=y
CONFIG_EMU_TIMER_IMX_GPT=y
CONFIG_EMU_CACHE_L2X0=y
CONFIG_EMU_MISC_ZERO=y
CONFIG_EMU_MISC_A9MPCORE=y
CONFIG_EMU_MISC_IMX6_ANATOP=y
CONFIG_EMU_MISC_IMX6_CCM=y
CONFIG_EMU_MISC_IMX6_APBH=y
CONFIG_EMU_NET=y
CONFIG_EMU_NET_LAN9118=y
CONFIG_EMU_NET_VIRTIO=y
CONFIG_EMU_BLOCK=y
CONFIG_EMU_BLOCK_VIRTIO=y
CONFIG_EMU_DISPLAY=y
CONFIG_EMU_DISPLAY_PL110=y
CONFIG_EMU_DISPLAY_SIMPLEFB=y
CONFIG_EMU_INPUT=y
CONFIG_EMU_INPUT_PS2=y
CONFIG_EMU_INPUT_PL050=y
CONFIG_EMU_SERIAL=y
CONFIG_EMU_SERIAL_PL011=y
CONFIG_EMU_SERIAL_IMX=y
CONFIG_EMU_CONSOLE=y
CONFIG_EMU_CONSOLE_VIRTIO=y
CONFIG_EMU_RTC=y
CONFIG_EMU_RTC_PL031=y
CONFIG_EMU_GPIO=y
CONFIG_EMU_GPIO_PL061=y
CONFIG_EMU_GPIO_POWER=y
CONFIG_EMU_WDT=y
CONFIG_EMU_WDT_SP805=y
```

## arch/riscv/configs/generic-64b-defconfig
```kconfig
CONFIG_ARCH_RISCV=y
CONFIG_RISCV_CPU_GENERIC=y
CONFIG_RISCV_64BIT=y
CONFIG_CMODEL_MEDANY=y
CONFIG_RISCV_BOARD_GENERIC=y
CONFIG_SCHEDALGO_PRR=y
CONFIG_TSLICE_10MS=y
CONFIG_BLOCK=y
CONFIG_NET=y
CONFIG_VIRTIO=y
CONFIG_VMSG=y
CONFIG_VSERIAL=y
CONFIG_VSPI=y
CONFIG_VDISK=y
CONFIG_VDISPLAY=y
CONFIG_VINPUT=y
CONFIG_VSDAEMON=y
CONFIG_VSDAEMON_CHARDEV=y
CONFIG_VSDAEMON_MTERM=y
CONFIG_VFS=y
CONFIG_VFS_CPIO=y
CONFIG_VFS_EXT4=y
CONFIG_VFS_FAT=y
CONFIG_SCSI=y
CONFIG_SCSI_DISK=y
CONFIG_RISCV_INTC=y
CONFIG_SIFIVE_PLIC=y
CONFIG_RISCV_TIMER=y
CONFIG_SERIAL=y
CONFIG_SERIAL_8250_UART=y
CONFIG_RTC=y
CONFIG_RTC_GOLDFISH=y
CONFIG_BLOCK_RBD=y
CONFIG_BLOCK_INITRD=y
CONFIG_BLOCK_VIRTIO_HOST=y
CONFIG_VIRTIO_HOST=y
CONFIG_VIRTIO_HOST_MMIO=y
CONFIG_EMU_VIRTIO_MMIO=y
CONFIG_EMU_SYS=y
CONFIG_EMU_SYS_VMINFO=y
CONFIG_EMU_PIC=y
CONFIG_EMU_PIC_PLIC=y
CONFIG_EMU_MISC_ZERO=y
CONFIG_EMU_PT_PLATFORM=y
CONFIG_EMU_NET=y
CONFIG_EMU_NET_VIRTIO=y
CONFIG_EMU_BLOCK=y
CONFIG_EMU_BLOCK_VIRTIO=y
CONFIG_EMU_DISPLAY=y
CONFIG_EMU_DISPLAY_SIMPLEFB=y
CONFIG_EMU_INPUT=y
CONFIG_EMU_INPUT_VIRTIO=y
CONFIG_EMU_SERIAL=y
CONFIG_EMU_SERIAL_NS16550=y
CONFIG_EMU_CONSOLE=y
CONFIG_EMU_CONSOLE_VIRTIO=y
CONFIG_EMU_RPMSG=y
CONFIG_EMU_RPMSG_VIRTIO=y
CONFIG_EMU_RTC=y
CONFIG_EMU_RTC_GOLDFISH=y
```
