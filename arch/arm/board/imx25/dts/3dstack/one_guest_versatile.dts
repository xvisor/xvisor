
/dts-v1/;

/include/ "3dstack.dtsi"

/ {
	chosen {
		bootcmd = /* Copy guest0 device tree from templates */
			  "devtree node copy /guests guest0 /templates/versatilepb",

			  /* Update guest0 memory regions */
			  "devtree attr set /guests/guest0/aspace/mem0 host_physical_addr physaddr 0x82000000",
			  "devtree attr set /guests/guest0/aspace/mem0 physical_size physsize 0x02000000",

			  /* Update guest0 flash region */
			  "devtree attr set /guests/guest0/aspace/nor_flash host_physical_addr physaddr 0x81000000",
			  "devtree attr set /guests/guest0/aspace/nor_flash physical_size physsize 0x01000000",

			  /* Connect guest0/eth netport to netbridge0 */
			  "devtree attr set /guests/guest0/aspace/eth switch string netbridge0",

			  /* Create guest0 */
			  "guest create guest0";
	};
};
