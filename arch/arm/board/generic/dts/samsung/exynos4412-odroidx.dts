
/dts-v1/;

#include "./exynos4412.dtsi"

/ {
	model = "odroidx";

	chosen {
		console = &SERIAL1;
		rtcdev = &RTC0;
	};

	memory {
		device_type = "memory"; 
		reg = <0x40000000 0x40000000>; /* 1 GB */
	};

	chosen {
		bootcmd = /* Mount initrd device */
			  "vfs mount initrd /",

			  /* Run boot script */
			  "vfs run /boot.xscript",

			  /* Print banner */
			  "vfs cat /system/banner.txt";
	};
};

