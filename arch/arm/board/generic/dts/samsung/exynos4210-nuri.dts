
/dts-v1/;

#include "./exynos4210.dtsi"

/ {
	model = "nuri";

	chosen {
		console = &SERIAL0;
		rtcdev = &RTC0;
	};

	memory {
		device_type = "memory"; 
		reg = <0x40000000 0x10000000>; /* 256 MB */
	};

	chosen {
		bootcmd = /* Mount initrd device */
			  "vfs mount initrd /",

			  /* Run boot script */
			  "vfs run /boot.xscript",

			  /* Print banner */
			  "vfs cat /system/banner.txt";
	};
};

