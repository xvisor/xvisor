
#include "../exynos4412.dtsi"

/ {
	model = "odroidx";

	chosen {
		console = &SERIAL1;
		rtcdev = &RTC0;
	};

	memory {
		device_type = "memory"; 
		reg = <0x40000000 0x40000000>; /* 1 GB */
	};
};

