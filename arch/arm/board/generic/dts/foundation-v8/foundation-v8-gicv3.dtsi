/*
 * ARMv8 Foundation model DTS (GICv3 configuration)
 */

#include "foundation-v8.dtsi"

/ {
	gic: interrupt-controller@2f000000 {
		compatible = "arm,gic-v3";
		#interrupt-cells = <3>;
		#address-cells = <2>;
		#size-cells = <2>;
		ranges;
		interrupt-controller;
		reg =	<0x0 0x2f000000 0x0 0x10000>,	/* GIC Dist */
			<0x0 0x2f100000 0x0 0x200000>,	/* GIC ReDist */
			<0x0 0x2c000000 0x0 0x2000>,
			<0x0 0x2c010000 0x0 0x2000>,
			<0x0 0x2c02f000 0x0 0x2000>;
		interrupts = <GIC_PPI 9 (GIC_CPU_MASK_SIMPLE(6) | IRQ_TYPE_LEVEL_HIGH)>;
	};
};
