
#include "../r8a7790.dtsi"

/ {
	model = "Lager";
	compatible = "renesas,lager", "renesas,r8a7790";

	aliases {
		serial0 = &scif0;
	};

	memory {
		device_type = "memory";
		reg = <0 0x40000000 0 0x40000000>,
		      <1 0x40000000 0 0xc0000000>;
	};
};

&scif0 {
	status = "okay";
};
