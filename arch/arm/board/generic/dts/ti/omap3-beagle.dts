
/dts-v1/;

/include/ "./omap3.dtsi"

/ {
        model = "BeagleBoard";
	compatible = "ti,omap3";

	chosen {
		console = &SERIAL0;
		bootcmd = /* Mount initrd device */
			  "vfs mount initrd /",

			  /* Run boot script */
			  "vfs run /boot.xscript",

			  /* Print banner */
			  "vfs cat /system/banner.txt";
	};
};
