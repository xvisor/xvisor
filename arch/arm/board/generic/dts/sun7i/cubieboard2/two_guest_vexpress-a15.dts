
/dts-v1/;

/include/ "sun7i-a20-cubieboard2.dtsi"

/ {
	chosen {
		console = &uart0;
		bootcmd = /* Create rbd0 device */
			  "rbd create rbd0 0x41000000 0x01000000",

			  /* Mount rbd0 device */
			  "vfs mount rbd0 /",

			  /* Copy guest0 device tree from templates */
			  "devtree node copy /guests guest0 /templates/vexpress-a15x2",

			  /* Update guest0 flash region */
			  "devtree attr set /guests/guest0/aspace/nor_flash0 host_physical_addr physaddr 0x42000000",
			  "devtree attr set /guests/guest0/aspace/nor_flash0 physical_size physsize 0x01000000",

			  /* Update guest0 sram regions */
			  "devtree attr set /guests/guest0/aspace/sram host_physical_addr physaddr 0x43000000",
			  "devtree attr set /guests/guest0/aspace/sram physical_size physsize 0x02000000",

			  /* Update guest0 videoram regions */
			  "devtree attr set /guests/guest0/aspace/videoram host_physical_addr physaddr 0x45000000",
			  "devtree attr set /guests/guest0/aspace/videoram physical_size physsize 0x00800000",

			  /* Update guest0 memory regions */
			  "devtree attr set /guests/guest0/aspace/mem0 host_physical_addr physaddr 0x45800000",
			  "devtree attr set /guests/guest0/aspace/mem0 physical_size physsize 0x06000000",

			  /* Update guest0 vGIC CPU interface regions */
			  "devtree attr set /guests/guest0/aspace/gic_cpu host_physical_addr physaddr 0x01C86000",

			  /* Connect guest0/eth netport to br0 */
			  "devtree attr set /guests/guest0/aspace/eth switch string br0",

			  /* Connect guest0/virtio-net0 netport to br0 */
			  "devtree attr set /guests/guest0/aspace/virtio-net0 switch string br0",

			  /* Create guest0 */
			  "guest create guest0",

			  /* Load guest0 images */
			  "vfs guest_load_list guest0 /images/arm32/vexpress-a15/nor_flash.list",

			  /* Copy guest1 device tree from templates */
			  "devtree node copy /guests guest1 /templates/vexpress-a15x2",

			  /* Update guest1 flash region */
			  "devtree attr set /guests/guest1/aspace/nor_flash0 host_physical_addr physaddr 0x4C000000",
			  "devtree attr set /guests/guest1/aspace/nor_flash0 physical_size physsize 0x01000000",

			  /* Update guest1 sram regions */
			  "devtree attr set /guests/guest1/aspace/sram host_physical_addr physaddr 0x4D000000",
			  "devtree attr set /guests/guest1/aspace/sram physical_size physsize 0x02000000",

			  /* Update guest1 videoram regions */
			  "devtree attr set /guests/guest1/aspace/videoram host_physical_addr physaddr 0x4F000000",
			  "devtree attr set /guests/guest1/aspace/videoram physical_size physsize 0x00800000",

			  /* Update guest1 memory regions */
			  "devtree attr set /guests/guest1/aspace/mem0 host_physical_addr physaddr 0x4F800000",
			  "devtree attr set /guests/guest1/aspace/mem0 physical_size physsize 0x06000000",

			  /* Update guest1 vGIC CPU interface regions */
			  "devtree attr set /guests/guest1/aspace/gic_cpu host_physical_addr physaddr 0x01c86000",

			  /* Connect guest1/eth netport to br0 */
			  "devtree attr set /guests/guest1/aspace/eth switch string br0",

			  /* Connect guest1/virtio-net0 netport to br0 */
			  "devtree attr set /guests/guest1/aspace/virtio-net0 switch string br0",

			  /* Create guest1 */
			  "guest create guest1",

			  /* Load guest1 images */
			  "vfs guest_load_list guest1 /images/arm32/vexpress-a15/nor_flash.list";
	};
};
