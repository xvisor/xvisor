
/dts-v1/;

/include/ "pb-a8.dtsi"

/ {
	choosen {
		console = &SERIAL0;
		rtcdev = &RTC0;
		bootcmd = /* Copy guest0 device tree from templates */
			  "devtree node copy /guests guest0 /templates/realview-pb-a8",

			  /* Pass through device access requires host IRQ to guest IRQ routing */
			  "devtree attr set /guests/guest0/aspace host2guest_irq_map uint32 45 44",

			  /* Update guest0 memory regions */
			  "devtree attr set /guests/guest0/aspace/mem0 physical_size physsize 0x06000000",
			  "devtree attr set /guests/guest0/aspace/mem1 host_physical_addr physaddr 0x72000000",
			  "devtree attr set /guests/guest0/aspace/mem1 physical_size physsize 0x06000000",

			  /* Make guest0/uart0 pass through device */
			  "devtree attr set /guests/guest0/aspace/uart0 manifest_type string real",
			  "devtree attr set /guests/guest0/aspace/uart0 address_type string memory",
			  "devtree attr set /guests/guest0/aspace/uart0 host_physical_addr physaddr 0x1000A000",
			  "devtree attr set /guests/guest0/aspace/uart0 device_type string serial",

			  /* Connect guest0/virtio-net0 netport to netbridge0 */
			  "devtree attr set /guests/guest0/aspace/virtio-net0 switch string netbridge0",

			  /* Update guest0 flash region */
			  "devtree attr set /guests/guest0/aspace/nor_flash host_physical_addr physaddr 0x71000000",
			  "devtree attr set /guests/guest0/aspace/nor_flash physical_size physsize 0x01000000",

			  /* Connect guest0/lan9118 netport to netbridge0 */
			  "devtree attr set /guests/guest0/aspace/lan9118 switch string netbridge0",

			  /* Create guest0 */
			  "guest create guest0",

			  /* Copy guest1 device tree from templates */
			  "devtree node copy /guests guest1 /templates/realview-pb-a8",

			  /* Pass through device access requires host IRQ to guest IRQ routing */
			  "devtree attr set /guests/guest1/aspace host2guest_irq_map uint32 46 44",

			  /* Update guest1 memory regions */
			  "devtree attr set /guests/guest1/aspace/mem0 physical_size physsize 0x06000000",
			  "devtree attr set /guests/guest1/aspace/mem1 host_physical_addr physaddr 0x79000000",
			  "devtree attr set /guests/guest1/aspace/mem1 physical_size physsize 0x06000000",

			  /* Make guest1/uart0 pass through device */
			  "devtree attr set /guests/guest1/aspace/uart0 manifest_type string real",
			  "devtree attr set /guests/guest1/aspace/uart0 address_type string memory",
			  "devtree attr set /guests/guest1/aspace/uart0 host_physical_addr physaddr 0x1000B000",
			  "devtree attr set /guests/guest1/aspace/uart0 device_type string serial",

			  /* Connect guest1/virtio-net0 netport to netbridge0 */
			  "devtree attr set /guests/guest1/aspace/virtio-net0 switch string netbridge0",

			  /* Update guest1 flash region */
			  "devtree attr set /guests/guest1/aspace/nor_flash host_physical_addr physaddr 0x78000000",
			  "devtree attr set /guests/guest1/aspace/nor_flash physical_size physsize 0x01000000",

			  /* Connect guest1/lan9118 netport to netbridge0 */
			  "devtree attr set /guests/guest1/aspace/lan9118 switch string netbridge0",

			  /* Create guest1 */
			  "guest create guest1";
	};
};
