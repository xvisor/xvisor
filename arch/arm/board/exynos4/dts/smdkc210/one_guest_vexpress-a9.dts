
/dts-v1/;

/include/ "smdkc210.dtsi"

/ {
	chosen {
		bootcmd = /* Copy guest0 device tree from templates */
			  "devtree node copy /guests guest0 /templates/vexpress-a9x2",

			  /* Update guest0 memory regions */
			  "devtree attr set /guests/guest0/aspace/mem0 physical_size physsize 0x04000000",
			  "devtree attr set /guests/guest0/aspace/mem1 host_physical_addr physaddr 0x42000000",
			  "devtree attr set /guests/guest0/aspace/mem1 physical_size physsize 0x06000000",

			  /* Connect guest0/virtio-net0 netport to netbridge0 */
			  "devtree attr set /guests/guest0/aspace/virtio-net0 switch string netbridge0",

			  /* Update guest0 flash region */
			  "devtree attr set /guests/guest0/aspace/nor_flash0 host_physical_addr physaddr 0x41000000",
			  "devtree attr set /guests/guest0/aspace/nor_flash0 physical_size physsize 0x01000000",

			  /* Connect guest0/lan9118 netport to netbridge0 */
			  "devtree attr set /guests/guest0/aspace/lan9118 switch string netbridge0",

			  /* Create guest0 */
			  "guest create guest0";
	};
};
