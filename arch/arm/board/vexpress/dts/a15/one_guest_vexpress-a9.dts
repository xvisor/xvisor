
/dts-v1/;

/include/ "vexpress-a15.dtsi"

/ {
	chosen {
		console = &SERIAL0;
		rtcdev = &RTC0;
		bootcmd = /* Copy guest0 device tree from templates */
			  "devtree node copy /guests guest0 /templates/vexpress-a9x2",

			  /* Update guest0 flash region */
			  "devtree attr set /guests/guest0/aspace/nor_flash0 host_physical_addr physaddr 0x81000000",
			  "devtree attr set /guests/guest0/aspace/nor_flash0 physical_size physsize 0x01000000",

			  /* Update guest0 sram regions */
			  "devtree attr set /guests/guest0/aspace/sram host_physical_addr physaddr 0x82000000",
			  "devtree attr set /guests/guest0/aspace/sram physical_size physsize 0x02000000",

			  /* Update guest0 videoram regions */
			  "devtree attr set /guests/guest0/aspace/videoram host_physical_addr physaddr 0x84000000",
			  "devtree attr set /guests/guest0/aspace/videoram physical_size physsize 0x00800000",

			  /* Update guest0 memory regions */
			  "devtree attr set /guests/guest0/aspace/mem0 physical_size physsize 0x04000000",
			  "devtree attr set /guests/guest0/aspace/mem1 host_physical_addr physaddr 0x84800000",
			  "devtree attr set /guests/guest0/aspace/mem1 physical_size physsize 0x06000000",

			  /* Connect guest0/virtio-net0 netport to br0 */
			  "devtree attr set /guests/guest0/aspace/virtio-net0 switch string br0",

			  /* Connect guest0/lan9118 netport to br0 */
			  "devtree attr set /guests/guest0/aspace/lan9118 switch string br0",

			  /* Create guest0 */
			  "guest create guest0";
	};
};
