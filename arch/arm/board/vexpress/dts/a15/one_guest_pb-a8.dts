
/dts-v1/;

/include/ "vexpress-a15.dtsi"

/ {
	chosen {
		console = &SERIAL0;
		rtcdev = &RTC0;
		bootcmd = /* Copy guest0 device tree from templates */
			  "devtree node copy /guests guest0 /templates/realview-pb-a8",

			  /* Update guest0 memory regions */
			  "devtree attr set /guests/guest0/aspace/mem0 physical_size physsize 0x06000000",
			  "devtree attr set /guests/guest0/aspace/mem1 host_physical_addr physaddr 0x82000000",
			  "devtree attr set /guests/guest0/aspace/mem1 physical_size physsize 0x06000000",

			  /* Connect guest0/virtio-net0 netport to br0 */
			  "devtree attr set /guests/guest0/aspace/virtio-net0 switch string br0",

			  /* Update guest0 flash region */
			  "devtree attr set /guests/guest0/aspace/nor_flash host_physical_addr physaddr 0x81000000",
			  "devtree attr set /guests/guest0/aspace/nor_flash physical_size physsize 0x01000000",

			  /* Connect guest0/lan9118 netport to br0 */
			  "devtree attr set /guests/guest0/aspace/lan9118 switch string br0",

			  /* Replace guest0 GIC emulator with vGIC emulator */
			  "devtree node copy /guests/guest0/aspace gic0_cpu /guests/guest0/aspace/gic0",
			  "devtree attr set /guests/guest0/aspace/gic0_cpu manifest_type string real",
			  "devtree attr set /guests/guest0/aspace/gic0_cpu guest_physical_addr physaddr 0x1E000000",
			  "devtree attr set /guests/guest0/aspace/gic0_cpu host_physical_addr physaddr 0x2C006000",
			  "devtree attr set /guests/guest0/aspace/gic0_cpu physical_size physsize 0x1000",
			  "devtree attr del /guests/guest0/aspace/gic0_cpu compatible",
			  "devtree attr del /guests/guest0/aspace/gic0_cpu parent_irq",
			  "devtree node copy /guests/guest0/aspace gic0_dist /guests/guest0/aspace/gic0",
			  "devtree attr set /guests/guest0/aspace/gic0_dist guest_physical_addr physaddr 0x1E001000",
			  "devtree attr set /guests/guest0/aspace/gic0_dist physical_size physsize 0x1000",
			  "devtree attr set /guests/guest0/aspace/gic0_dist compatible string arm,vgic",
			  "devtree attr set /guests/guest0/aspace/gic0_dist num_irq uint32 96",
			  "devtree node del /guests/guest0/aspace/gic0",

			  /* Create guest0 */
			  "guest create guest0";
	};
};
