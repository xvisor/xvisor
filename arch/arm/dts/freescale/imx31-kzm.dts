
/dts-v1/;

/include/ "imx31.dtsi"

/ {
	model = "kzm";

	chosen {
		console = &SERIAL1;
		bootcmd = /* Mount initrd device */
			  "vfs mount initrd /",

			  /* Run boot script */
			  "vfs run /boot.xscript",

			  /* Print banner */
			  "vfs cat /system/banner.txt";
	};

	memory {
		device_type = "memory"; 
		reg = <0x80000000 0x10000000>; /* 256 MB */
	};
};

