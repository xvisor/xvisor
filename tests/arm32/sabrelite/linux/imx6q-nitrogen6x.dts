/*
 * Copyright 2013 Boundary Devices
 * Copyright 2012 Freescale Semiconductor, Inc.
 * Copyright 2011 Linaro Ltd.
 *
 * The code contained herein is licensed under the GNU General Public
 * License. You may obtain a copy of the GNU General Public License
 * Version 2 or later at the following locations:
 *
 * http://www.opensource.org/licenses/gpl-license.html
 * http://www.gnu.org/copyleft/gpl.html
 */

/dts-v1/;

#include <dt-bindings/interrupt-controller/irq.h>
#include "imx6q.dtsi"
#include "imx6qdl-nitrogen6x.dtsi"

/ {
	model = "Freescale i.MX6 Quad Nitrogen6x Board";
	compatible = "fsl,imx6q-nitrogen6x", "fsl,imx6q";
};

/* &hdmi_core { */
/* 	ipu_id = <1>; */
/* }; */

&mxcfb1 {
	status = "okay";
};

/* &mxcfb2 { */
/* 	status = "okay"; */
/* }; */

/* &mxcfb3 { */
/* 	status = "okay"; */
/* }; */

/* &mxcfb4 { */
/* 	status = "okay"; */
/* }; */

/* &ov5640 { */
/* 	ipu_id = <1>; */
/* }; */

/* &ov5640_mipi { */
/* 	ipu_id = <1>; */
/* 	csi_id = <0>; */
/* }; */

&pinctrl_ov5640 { /* parallel camera */
	fsl,pins = <
		MX6QDL_PAD_EIM_A17__IPU2_CSI1_DATA12	0xb0b1
		MX6QDL_PAD_EIM_A18__IPU2_CSI1_DATA13	0xb0b1
		MX6QDL_PAD_EIM_A19__IPU2_CSI1_DATA14	0xb0b1
		MX6QDL_PAD_EIM_A20__IPU2_CSI1_DATA15	0xb0b1
		MX6QDL_PAD_EIM_A21__IPU2_CSI1_DATA16	0xb0b1
		MX6QDL_PAD_EIM_A22__IPU2_CSI1_DATA17	0xb0b1
		MX6QDL_PAD_EIM_A23__IPU2_CSI1_DATA18	0xb0b1
		MX6QDL_PAD_EIM_EB2__IPU2_CSI1_DATA19	0xb0b1
		MX6QDL_PAD_EIM_DA10__IPU2_CSI1_DATA_EN	0xb0b1
		MX6QDL_PAD_EIM_A16__IPU2_CSI1_PIXCLK	0xb0b1
		MX6QDL_PAD_EIM_DA11__IPU2_CSI1_HSYNC	0xb0b1
		MX6QDL_PAD_EIM_DA12__IPU2_CSI1_VSYNC	0xb0b1
	>;
};

/* &sata { */
/* 	status = "okay"; */
/* }; */

/* /\* ov5640_mipi *\/ */
/* &v4l2_cap_1 { */
/* 	ipu_id = <1>; */
/* 	csi_id = <0>; */
/* 	mipi_camera = <1>; */
/* }; */

